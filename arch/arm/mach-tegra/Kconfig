## arch/arm/mach-tegra/Kconfig
```kconfig
if ARCH_TEGRA

comment "NVIDIA Tegra options"

config WLAN_ALLOC_STATIC_MEM
	bool "Wlan Driver allocate bootmem"
	default y
	help 
		wlan driver use alloc_bootmem memory for size then 2 pages

choice
	prompt "Select Tegra processor family for target system"

config ARCH_TEGRA_2x_SOC
	bool "Tegra 2 family"
	select CPU_V7
	select ARM_GIC
	select ARCH_REQUIRE_GPIOLIB
	select ARM_ERRATA_742230
	select USB_ARCH_HAS_EHCI if USB_SUPPORT
	select USB_ULPI if USB_SUPPORT
	select USB_ULPI_VIEWPORT if USB_SUPPORT
	select DISABLE_3D_POWERGATING
	help
	  Support for NVIDIA Tegra AP20 and T20 processors, based on the
	  ARM CortexA9MP CPU and the ARM PL310 L2 cache controller

endchoice

comment "Tegra board type"

config MACH_HARMONY
       bool "Harmony board"
       help
         Support for NVIDIA Harmony development platform

config MACH_VENTANA
       bool "Ventana board"
       help
         Support for NVIDIA Ventana development platform

config MACH_WHISTLER
       bool "Whistler board"
       help
         Support for NVIDIA Whistler development platform

choice
        prompt "Low-level debug console UART"
        default TEGRA_DEBUG_UART_NONE

config TEGRA_DEBUG_UART_NONE
        bool "None"

config TEGRA_DEBUG_UARTA
        bool "UART-A"

config TEGRA_DEBUG_UARTB
        bool "UART-B"

config TEGRA_DEBUG_UARTC
        bool "UART-C"

config TEGRA_DEBUG_UARTD
        bool "UART-D"

config TEGRA_DEBUG_UARTE
        bool "UART-E"

endchoice

choice
       prompt "Tegra platform type"
       depends on ICS
       default TEGRA_SILICON_PLATFORM

config TEGRA_SILICON_PLATFORM
        bool "Silicon"
        help
          This enables support for a Tegra silicon platform.

config TEGRA_SIMULATION_PLATFORM
        bool "Simulation"
        help
          This enables support for a Tegra simulation platform.
          Select this only if you are an NVIDIA developer working
          on a simulation platform.

config TEGRA_FPGA_PLATFORM
        bool "FPGA"
        help
          This enables support for a Tegra FPGA platform.
          Select this only if you are an NVIDIA developer working
          on a FPGA platform.
endchoice

config TEGRA_EMC_TO_DDR_CLOCK
        int "EMC to DDR clocks ratio"
  depends on ICS
        default "2" if ARCH_TEGRA_2x_SOC
        default "1"

choice
	prompt "Kernel Build Revision"
	default BUILDTYPE_SHIP

	config BUILDTYPE_RELEASE
		bool "RELEASE"

	config BUILDTYPE_SHIP
		bool "SHIP"
endchoice

config TEGRA_SYSTEM_DMA
	bool "Enable system DMA driver for NVIDIA Tegra SoCs"
	default y
	help
	  Adds system DMA functionality for NVIDIA Tegra SoCs, used by
	  several Tegra device drivers

config TEGRA_SPI_SLAVE
       tristate "Nvidia Tegra SPI slave driver"
       depends on ARCH_TEGRA
       select TEGRA_SYSTEM_DMA
       help
         SPI slave driver for NVIDIA Tegra SoCs

config TEGRA_OC
  bool "Enable 1.2Ghz Overclock"
  default n

config TEGRA_PWM
	tristate "Enable PWM driver"
	select HAVE_PWM
	help
	  Enable support for the Tegra PWM controller(s).

config TEGRA_FIQ_DEBUGGER
	bool "Enable the FIQ serial debugger on Tegra"
	default y
	select FIQ_DEBUGGER
	help
	  Enables the FIQ serial debugger on Tegra"

source "arch/arm/mach-tegra/nv/Kconfig"

endif

config TEGRA_EMC_SCALING_ENABLE
	bool "Enable scaling the memory frequency"
	default n

config TEGRA_CPU_DVFS
	bool "Enable voltage scaling on Tegra CPU"
	default y

config TEGRA_CORE_DVFS
	bool "Enable voltage scaling on Tegra core"
	depends on TEGRA_CPU_DVFS
	default y

config TEGRA_IOVMM_GART
	bool "Enable I/O virtual memory manager for GART"
	depends on ARCH_TEGRA_2x_SOC
	default y
	select TEGRA_IOVMM
	help
	  Enables support for remapping discontiguous physical memory
	  shared with the operating system into contiguous I/O virtual
	  space through the GART hardware included on Tegra SoCs

config TEGRA_IOVMM
	bool

config TEGRA_AVP_KERNEL_ON_MMU
        bool "Use AVP MMU to relocate AVP kernel"
        depends on ARCH_TEGRA_2x_SOC && ICS
        default y
        help
          Use AVP MMU to relocate AVP kernel (nvrm_avp.bin).

config TEGRA_ARB_SEMAPHORE
	bool

config TEGRA_THERMAL_THROTTLE
       bool "Enable throttling of CPU speed on overtemp"
       depends on CPU_FREQ
       default y
       help
         Also requires enabling a temperature sensor such as NCT1008.

config TEGRA_CLOCK_DEBUG_WRITE
	bool "Enable debugfs write access to clock tree"
	depends on DEBUG_FS
	default n
config POWER_MANAGEMENT_LOG
	bool "System power management state logging"
	default y
	help
	  Enable power management mechanism.

config TEGRA_MC_PROFILE
	tristate "Enable profiling memory controller utilization"
	default n
	help
	  When enabled, provides a mechanism to perform statistical
	  sampling of the memory controller usage on a client-by-client
	  basis, and report the log through sysfs.

config TEGRA_CPU_FREQ_LOCK
	bool "Enable locking and unlocking CPU frequency"
 	depends on CPU_FREQ
 	default n
 	help
 	    When enabled, provides a mechanism to change minimum CPU
 	    frequency with specific value. Once CPU frequency locked,
 	    CPU DVFS is working but its frequency doesn't go down to set value.  
 		
config TEGRA_CPU_FREQ_SET_MIN_MAX
	bool "Set Min/Max CPU frequencies."
 	depends on CPU_FREQ
 	default n
 	help
 	    Allow setting min and max CPU frequencies. Sysfs can be used
 	    to override these values.
 		
config TEGRA_CPU_FREQ_MAX
 	int "Max CPU Frequency"
 	depends on TEGRA_CPU_FREQ_SET_MIN_MAX
 	default 1000000
 	
 	
config TEGRA_CPU_FREQ_MIN
	int "Min CPU Frequency"
 	depends on TEGRA_CPU_FREQ_SET_MIN_MAX
 	default 216000

config DISABLE_3D_POWERGATING
	bool "Disable 3D power gate"
	depends on ARCH_TEGRA_2x_SOC
	help
	  This is for silicon errata of 3D power gating. By setting this
	  config, 3D power will never be gated.

config TEGRA_STAT_MON
	bool "Enable H/W statistics monitor"
	depends on ARCH_TEGRA_2x_SOC
	default n
	help
	  Enables support for hardware statistics monitor for AVP.

config ALLOC_MEMORY_EARLY_FOR_SDCARD_DETECTION
	bool "allocate memory in sd card driver early for sdcard detection"
	default y
	help 
		allocate memory in sd card driver early for sdcard detection
```

## drivers/i2c/muxes/Kconfig
```kconfig
#
# Multiplexer I2C chip drivers configuration
#

menu "Multiplexer I2C Chip support"
	depends on I2C_MUX

config I2C_MUX_PCA954x
	tristate "Philips PCA954x I2C Mux/switches"
	depends on EXPERIMENTAL
	help
	  If you say yes here you get support for the Philips PCA954x
	  I2C mux/switch devices.

	  This driver can also be built as a module.  If so, the module
	  will be called pca954x.

config GSENSOR_BOSCH_BMA150
	tristate "Bosch BMA150 accelerometer with using I2C interface"
	default y
	help
	  Say Y here if you want support for the BMA150 accelerometer
	  device.

	  To compile this driver as a module, choose M here: the
	  module will be called gsensor-bosch-bma150.

config ECOMPASS_AKM_AK8973S
	tristate "AKM AK8973S geomagnetism detection with using I2C interface"
	default y
	help
	  Say Y here if you want support for the  AK8973S geomagnetism
	  detection device.

	  To compile this driver as a module, choose M here: the
	  module will be called ecompass-akm-ak8973s.

config LUNA_LSENSOR
	bool "Luna light sensor"
	depends on ARCH_TEGRA
	default y
	help
	  Luna Light Sensor
config LUNA_VIBRATOR
	boolean "Luna Vibrator"
	depends on ARCH_TEGRA && ANDROID_TIMED_OUTPUT
	default y
	help
	  Luna Vibrator

endmenu
```

## drivers/switch/Kconfig
```kconfig
menuconfig SWITCH
	tristate "Switch class support"
	help
	  Say Y here to enable switch class support. This allows
	  monitoring switches by userspace via sysfs and uevent.

if SWITCH

config SWITCH_GPIO
	tristate "GPIO Swith support"
	depends on GENERIC_GPIO
	help
	  Say Y here to enable GPIO based switch support.

config USIM_PLUG
	tristate "USIM plug detection"
	depends on GENERIC_GPIO
	help
	  Say Y here if you want to enable USIM plug detection.

	  To compile the driver as a module, choose M here: the
	  module will be called usimplug.

endif # SWITCH
```
